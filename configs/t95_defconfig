## configs/t95_defconfig
```kconfig
CONFIG_ARM=y
CONFIG_ARCH_SUNXI=y
CONFIG_DEFAULT_DEVICE_TREE="sun50i-h616-t95"
CONFIG_SPL=y
CONFIG_DRAM_SUN50I_H616_DX_ODT=0x08080808
CONFIG_DRAM_SUN50I_H616_DX_DRI=0x0e0e0e0e
CONFIG_DRAM_SUN50I_H616_CA_DRI=0x1c1c
CONFIG_DRAM_SUN50I_H616_TPR0=0x80000007
CONFIG_DRAM_SUN50I_H616_TPR10=0x2f44b7
CONFIG_DRAM_SUN50I_H616_TPR11=0xfffedddb
CONFIG_DRAM_SUN50I_H616_TPR12=0xeddca998
CONFIG_SUNXI_DRAM_H616_DDR3_1333=y
CONFIG_MACH_SUN50I_H616=y
CONFIG_R_I2C_ENABLE=y
# CONFIG_SYS_MALLOC_CLEAR_ON_INIT is not set
CONFIG_SPL_I2C=y
CONFIG_SPL_SYS_I2C_LEGACY=y
CONFIG_SYS_I2C_MVTWSI=y
CONFIG_SYS_I2C_SLAVE=0x7f
CONFIG_SYS_I2C_SPEED=100000
CONFIG_SUN8I_EMAC=y
CONFIG_I2C3_ENABLE=y
CONFIG_SUPPORT_EMMC_BOOT=y
CONFIG_USB_EHCI_HCD=y
CONFIG_USB_OHCI_HCD=y
CONFIG_SPL_IMAGE_TYPE_SUNXI_TOC0=y
CONFIG_AXP313_POWER=y
CONFIG_AXP_DCDC1_VOLT=960
CONFIG_AXP_DCDC2_VOLT=1120
CONFIG_AXP_DCDC3_VOLT=1420
CONFIG_AXP_ALDO1_VOLT=1800
CONFIG_AXP_DLDO1_VOLT=3300
```
